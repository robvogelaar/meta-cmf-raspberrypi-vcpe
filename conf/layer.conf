## conf/layer.conf
```bitbake
# We have a conf and classes directory, add to BBPATH
BBPATH .= ":${LAYERDIR}"

# We have recipes-* directories, add to BBFILES
BBFILES += "${LAYERDIR}/recipes-*/*/*.bb \
            ${LAYERDIR}/recipes-*/*/*.bbappend"

BBFILE_COLLECTIONS += "meta-cmf-raspberrypi-vcpe"
BBFILE_PATTERN_meta-cmf-raspberrypi-vcpe = "^${LAYERDIR}/"
BBFILE_PRIORITY_meta-cmf-raspberrypi-vcpe = "10"

LAYERDEPENDS_meta-cmf-raspberrypi-vcpe = "core"
LAYERSERIES_COMPAT_meta-cmf-raspberrypi-vcpe = "kirkstone"
```
